## sdkconfig.defaults
```kconfig
# ESP32 target
CONFIG_IDF_TARGET="esp32"

# Flash
CONFIG_ESPTOOLPY_FLASHSIZE_4MB=y
CONFIG_PARTITION_TABLE_CUSTOM=y
CONFIG_PARTITION_TABLE_CUSTOM_FILENAME="partitions.csv"

# FreeRTOS
CONFIG_FREERTOS_HZ=1000

# lwIP
CONFIG_LWIP_MAX_SOCKETS=16
CONFIG_LWIP_DNS_SUPPORT_MDNS_QUERIES=y

# HTTPD
CONFIG_HTTPD_MAX_REQ_HDR_LEN=1024
CONFIG_HTTPD_MAX_URI_LEN=512

# MQTT
CONFIG_MQTT_PROTOCOL_311=y

# OTA
CONFIG_ESP_HTTPS_OTA_ALLOW_HTTP=y

# Log level
CONFIG_LOG_DEFAULT_LEVEL_INFO=y

# Watchdog
CONFIG_ESP_TASK_WDT_TIMEOUT_S=30

# Stack sizes
CONFIG_ESP_MAIN_TASK_STACK_SIZE=8192
```
