/*
 * cal_tool — XPT2046 raw ADC value display for ESP32-2432S028 (CYD).
 *
 * Shows live raw X and Y ADC values from the touch controller on screen.
 * Tap each corner of the screen and write down the X and Y values shown.
 * Report the 8 values (X and Y for each of 4 corners) so that calibration
 * data can be hardcoded into the main firmware.
 *
 * Build & flash:
 *   cd cal_tool
 *   idf.py set-target esp32
 *   idf.py build
 *   idf.py flash
 */
#include <stdio.h>
#include <string.h>
#include "freertos/FreeRTOS.h"
#include "freertos/task.h"
#include "driver/spi_master.h"
#include "driver/gpio.h"
#include "nvs_flash.h"

/* ── Pin definitions (CYD ESP32-2432S028) ─────────────────────────────── */
#define LCD_MOSI    13
#define LCD_SCLK    14
#define LCD_CS      15
#define LCD_DC       2
#define LCD_BL      21
#define LCD_W      320
#define LCD_H      240

#define TCH_CLK     25
#define TCH_MOSI    32
#define TCH_MISO    39
#define TCH_CS      33
#define TCH_IRQ     36

/* ── RGB565 colors (R/B pre-swapped for BGR panel) ────────────────────── */
#define BLACK   0x0000u
#define WHITE   0xFFFFu
#define CYAN    0xFFE0u
#define YELLOW  0x07FFu
#define GREEN   0x07E0u
#define GRAY    0x8410u
#define RED     0x001Fu
#define ORANGE  0x053Fu

/* ── 8×8 font, ASCII 32–126, bit0 = leftmost pixel ─────────────────────  */
static const uint8_t FONT[95][8] = {
    {0x00,0x00,0x00,0x00,0x00,0x00,0x00,0x00},
    {0x18,0x3C,0x3C,0x18,0x18,0x00,0x18,0x00},
    {0x36,0x36,0x00,0x00,0x00,0x00,0x00,0x00},
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    {0x6E,0x3B,0x00,0x00,0x00,0x00,0x00,0x00},
};

/* ── SPI handles ─────────────────────────────────────────────────────────── */
static spi_device_handle_t s_lcd;
static spi_device_handle_t s_tch;

/* ── Pixel buffer ────────────────────────────────────────────────────────── */
#define PBUF 2048
static uint16_t s_pb[PBUF];

/* ── DC pin callback ─────────────────────────────────────────────────────── */
static void IRAM_ATTR dc_cb(spi_transaction_t *t)
{
    gpio_set_level(LCD_DC, (int)(intptr_t)t->user);
}

static void lcd_cmd(uint8_t c)
{
    spi_transaction_t t = { .length=8, .flags=SPI_TRANS_USE_TXDATA,
                             .tx_data={c}, .user=(void*)0 };
    spi_device_polling_transmit(s_lcd, &t);
}
static void lcd_d1(uint8_t b)
{
    spi_transaction_t t = { .length=8, .flags=SPI_TRANS_USE_TXDATA,
                             .tx_data={b}, .user=(void*)1 };
    spi_device_polling_transmit(s_lcd, &t);
}
static void lcd_dn(const uint8_t *d, int n)
{
    spi_transaction_t t = { .length=n*8, .tx_buffer=d, .user=(void*)1 };
    spi_device_polling_transmit(s_lcd, &t);
}

static inline uint16_t enc(uint16_t c) { return (c>>8)|(c<<8); }

static void fill_pixels(uint16_t ce, int n)
{
    int f = n < PBUF ? n : PBUF;
    for (int i=0; i<f; i++) s_pb[i] = ce;
    while (n > 0) {
        int k = n > PBUF ? PBUF : n;
        spi_transaction_t t = { .length=k*16, .tx_buffer=s_pb, .user=(void*)1 };
        spi_device_polling_transmit(s_lcd, &t);
        n -= k;
    }
}

static void set_win(int x0, int y0, int x1, int y1)
{
    uint8_t b[4];
    lcd_cmd(0x2A); b[0]=x0>>8; b[1]=x0; b[2]=x1>>8; b[3]=x1; lcd_dn(b,4);
    lcd_cmd(0x2B); b[0]=y0>>8; b[1]=y0; b[2]=y1>>8; b[3]=y1; lcd_dn(b,4);
    lcd_cmd(0x2C);
}

static void fill_rect(int x, int y, int w, int h, uint16_t col)
{
    if (w<=0||h<=0) return;
    if (x<0){w+=x;x=0;}
    if (y<0){h+=y;y=0;}
    if (x>=LCD_W||y>=LCD_H) return;
    if (x+w>LCD_W) w=LCD_W-x;
    if (y+h>LCD_H) h=LCD_H-y;
    if (w<=0||h<=0) return;
    set_win(x,y,x+w-1,y+h-1);
    fill_pixels(enc(col), w*h);
}

static void draw_char(int x, int y, char c, uint16_t fg, uint16_t bg, int sc)
{
    if (c<32||c>126) return;
    const uint8_t *g = FONT[(uint8_t)c-32];
    int w=8*sc, h=8*sc;
    uint16_t fe=enc(fg), be=enc(bg);
    for (int row=0; row<8; row++) {
        uint8_t ln = g[row];
        for (int rs=0; rs<sc; rs++) {
            int br = (row*sc+rs)*w;
            for (int col=0; col<8; col++) {
                uint16_t px = (ln&(1<<col)) ? fe : be;
                for (int cs=0; cs<sc; cs++) s_pb[br+col*sc+cs]=px;
            }
        }
    }
    set_win(x,y,x+w-1,y+h-1);
    spi_transaction_t t={.length=w*h*16,.tx_buffer=s_pb,.user=(void*)1};
    spi_device_polling_transmit(s_lcd, &t);
}

static void draw_str(int x, int y, const char *s, uint16_t fg, uint16_t bg, int sc)
{
    while (*s) { draw_char(x,y,*s++,fg,bg,sc); x+=8*sc; if(x>=LCD_W) break; }
}

/* ── ILI9341 init ────────────────────────────────────────────────────────── */
static void lcd_init(void)
{
    lcd_cmd(0x01); vTaskDelay(pdMS_TO_TICKS(120));
    lcd_cmd(0xEF); lcd_dn((uint8_t[]){0x03,0x80,0x02},3);
    lcd_cmd(0xCF); lcd_dn((uint8_t[]){0x00,0xC1,0x30},3);
    lcd_cmd(0xED); lcd_dn((uint8_t[]){0x64,0x03,0x12,0x81},4);
    lcd_cmd(0xE8); lcd_dn((uint8_t[]){0x85,0x00,0x78},3);
    lcd_cmd(0xCB); lcd_dn((uint8_t[]){0x39,0x2C,0x00,0x34,0x02},5);
    lcd_cmd(0xF7); lcd_d1(0x20);
    lcd_cmd(0xEA); lcd_dn((uint8_t[]){0x00,0x00},2);
    lcd_cmd(0xC0); lcd_d1(0x23);
    lcd_cmd(0xC1); lcd_d1(0x10);
    lcd_cmd(0xC5); lcd_dn((uint8_t[]){0x3E,0x28},2);
    lcd_cmd(0xC7); lcd_d1(0x86);
    lcd_cmd(0x36); lcd_d1(0x48);   // MADCTL: MX=1, BGR=1
    lcd_cmd(0x3A); lcd_d1(0x55);   // 16-bit color
    lcd_cmd(0xB1); lcd_dn((uint8_t[]){0x00,0x18},2);
    lcd_cmd(0xB6); lcd_dn((uint8_t[]){0x08,0x82,0x27},3);
    lcd_cmd(0xF2); lcd_d1(0x00);
    lcd_cmd(0x26); lcd_d1(0x01);
    lcd_cmd(0xE0); lcd_dn((uint8_t[]){0x0F,0x31,0x2B,0x0C,0x0E,0x08,0x4E,0xF1,
                                       0x37,0x07,0x10,0x03,0x0E,0x09,0x00},15);
    lcd_cmd(0xE1); lcd_dn((uint8_t[]){0x00,0x0E,0x14,0x03,0x11,0x07,0x31,0xC1,
                                       0x48,0x08,0x0F,0x0C,0x31,0x36,0x0F},15);
    lcd_cmd(0x11); vTaskDelay(pdMS_TO_TICKS(120));
    lcd_cmd(0x29); vTaskDelay(pdMS_TO_TICKS(20));
}

/* ── XPT2046 raw read ────────────────────────────────────────────────────── */
static uint16_t tch_ch(uint8_t cmd)
{
    spi_transaction_t t = {
        .length=24, .flags=SPI_TRANS_USE_TXDATA|SPI_TRANS_USE_RXDATA,
    };
    t.tx_data[0]=cmd; t.tx_data[1]=0; t.tx_data[2]=0;
    spi_device_polling_transmit(s_tch, &t);
    return ((uint16_t)t.rx_data[1]<<8 | t.rx_data[2]) >> 3;
}

/* Returns true if screen is touched; rx/ry = averaged raw ADC values */
static bool tch_raw(int *rx, int *ry)
{
    if (gpio_get_level(TCH_IRQ) != 0) return false;
    int32_t ax=0, ay=0;
    for (int i=0; i<8; i++) { ax += tch_ch(0xD0); ay += tch_ch(0x90); }
    *rx = (int)(ax/8);
    *ry = (int)(ay/8);
    return true;
}

/* ── Main ────────────────────────────────────────────────────────────────── */
void app_main(void)
{
    nvs_flash_init();

    /* Backlight on */
    gpio_config_t bl = {.pin_bit_mask=(1ULL<<LCD_BL),.mode=GPIO_MODE_OUTPUT};
    gpio_config(&bl);
    gpio_set_level(LCD_BL, 1);

    /* DC pin */
    gpio_config_t dc = {.pin_bit_mask=(1ULL<<LCD_DC),.mode=GPIO_MODE_OUTPUT};
    gpio_config(&dc);
    gpio_set_level(LCD_DC, 1);

    /* LCD SPI (SPI2) */
    spi_bus_config_t lbus = {
        .mosi_io_num=LCD_MOSI, .miso_io_num=-1, .sclk_io_num=LCD_SCLK,
        .quadwp_io_num=-1, .quadhd_io_num=-1, .max_transfer_sz=PBUF*2,
    };
    spi_bus_initialize(SPI2_HOST, &lbus, SPI_DMA_CH_AUTO);
    spi_device_interface_config_t ldev = {
        .clock_speed_hz=40000000, .mode=0, .spics_io_num=LCD_CS,
        .queue_size=7, .pre_cb=dc_cb,
    };
    spi_bus_add_device(SPI2_HOST, &ldev, &s_lcd);
    lcd_init();
    fill_rect(0,0,LCD_W,LCD_H,BLACK);

    /* Touch IRQ input */
    gpio_config_t irq = {
        .pin_bit_mask=(1ULL<<TCH_IRQ), .mode=GPIO_MODE_INPUT,
        .pull_up_en=GPIO_PULLUP_ENABLE, .intr_type=GPIO_INTR_DISABLE,
    };
    gpio_config(&irq);

    /* Touch SPI (SPI3) */
    spi_bus_config_t tbus = {
        .mosi_io_num=TCH_MOSI, .miso_io_num=TCH_MISO, .sclk_io_num=TCH_CLK,
        .quadwp_io_num=-1, .quadhd_io_num=-1, .max_transfer_sz=8,
    };
    spi_bus_initialize(SPI3_HOST, &tbus, SPI_DMA_DISABLED);
    spi_device_interface_config_t tdev = {
        .clock_speed_hz=2000000, .mode=0, .spics_io_num=TCH_CS, .queue_size=1,
    };
    spi_bus_add_device(SPI3_HOST, &tdev, &s_tch);

    /* Static UI */
    draw_str(4, 4, "CYD Touch Calibration Tool", CYAN, BLACK, 1);
    fill_rect(0, 14, LCD_W, 1, GRAY);
    draw_str(4, 18, "Tap each corner. Note X and Y.", WHITE, BLACK, 1);
    draw_str(4, 28, "Tell all 8 values to Claude.", GRAY,  BLACK, 1);
    fill_rect(0, 38, LCD_W, 1, GRAY);

    /* Corner labels — drawn at each physical corner */
    draw_str(2,   2,   "TL", ORANGE, BLACK, 1);  // top-left  (overdrawn below)
    draw_str(296, 2,   "TR", ORANGE, BLACK, 1);  // top-right
    draw_str(296, 232, "BR", ORANGE, BLACK, 1);  // bot-right
    draw_str(2,   232, "BL", ORANGE, BLACK, 1);  // bot-left

    /* Re-draw corner labels outside the static header */
    fill_rect(0, 0, LCD_W, 38, BLACK);
    draw_str(4, 4,  "CYD Touch Calibration Tool", CYAN, BLACK, 1);
    fill_rect(0, 14, LCD_W, 1, GRAY);
    draw_str(4, 18, "Tap corner, note X+Y values", WHITE, BLACK, 1);
    draw_str(4, 28, "Tell 8 values to Claude", GRAY, BLACK, 1);
    fill_rect(0, 38, LCD_W, 1, GRAY);

    /* Corner cross-hair markers at screen corners */
    /* Top-left */
    fill_rect( 0,  0, 20, 1, ORANGE); fill_rect( 0,  0, 1, 20, ORANGE);
    /* Top-right */
    fill_rect(300, 0, 20, 1, ORANGE); fill_rect(319, 0, 1, 20, ORANGE);
    /* Bottom-right */
    fill_rect(300,239,20,1,ORANGE); fill_rect(319,220,1,20,ORANGE);
    /* Bottom-left */
    fill_rect(  0,239,20,1,ORANGE); fill_rect(  0,220,1,20,ORANGE);

    char buf[32];
    int prev_rx=-1, prev_ry=-1;
    bool prev_tch=false;

    while (1) {
        int rx=0, ry=0;
        bool tch = tch_raw(&rx, &ry);

        /* Only redraw live area when state changes */
        if (tch != prev_tch || (tch && (rx != prev_rx || ry != prev_ry))) {

            /* Clear live value area */
            fill_rect(0, 42, LCD_W, 100, BLACK);

            if (tch) {
                /* Large raw values */
                snprintf(buf, sizeof(buf), "X:%4d", rx);
                draw_str(8, 50, buf, CYAN, BLACK, 3);   // scale 3 = 24px/char

                snprintf(buf, sizeof(buf), "Y:%4d", ry);
                draw_str(8, 86, buf, YELLOW, BLACK, 3);

                /* Erase old dot */
                if (prev_rx >= 0) {
                    int px = prev_rx * LCD_W / 4095;
                    int py = 130 + prev_ry * (LCD_H - 130) / 4095;
                    fill_rect(px-5, py-5, 11, 11, BLACK);
                }
                /* Draw dot at proportional position (raw 0-4095 → screen) */
                int dx = rx * LCD_W / 4095;
                int dy = 130 + ry * (LCD_H - 130) / 4095;
                fill_rect(dx-5, dy-5, 11, 11, GREEN);

            } else {
                draw_str(8, 50, "X:----", GRAY, BLACK, 3);
                draw_str(8, 86, "Y:----", GRAY, BLACK, 3);

                /* Erase dot */
                if (prev_rx >= 0) {
                    int px = prev_rx * LCD_W / 4095;
                    int py = 130 + prev_ry * (LCD_H - 130) / 4095;
                    fill_rect(px-5, py-5, 11, 11, BLACK);
                }
            }

            prev_tch = tch;
            prev_rx  = tch ? rx : -1;
            prev_ry  = tch ? ry : -1;
        }

        vTaskDelay(pdMS_TO_TICKS(80));
    }
}
